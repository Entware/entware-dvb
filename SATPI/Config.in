## SATPI/Config.in
```kconfig
# SATPI avanced configuration

menu "Configuration"
	depends on PACKAGE_SATPI

config SATPI_DVBCSA_SUPPORT
	bool "DVBCSA support (Oscam client)"
	default n

endmenu
```

## minisatip/Config.in
```kconfig
# minisatip avanced configuration

menu "Configuration"
	depends on PACKAGE_minisatip

config MINISATIP_DVBCSA_SUPPORT
	bool "DVBCSA support (Oscam client)"
	default n

config MINISATIP_DVBAES_SUPPORT
	bool "AES support"
	default n

config MINISATIP_DVBCA_SUPPORT
        depends on MINISATIP_DVBCSA_SUPPORT && MINISATIP_DVBAES_SUPPORT
	bool "CAM module CI/CI+ support"
	default n

config MINISATIP_CLIENT_SUPPORT
	bool "SatIP client support"
	default n

endmenu
```

## minisatip_ndms/Config.in
```kconfig
# minisatip avanced configuration

menu "Configuration"
	depends on PACKAGE_minisatip_ndms

config MINISATIP_NDMS_DVBCSA_SUPPORT
	bool "DVBCSA support (Oscam client)"
	default n

config MINISATIP_NDMS_DVBAES_SUPPORT
	bool "AES support"
	default n

config MINISATIP_NDMS_DVBCA_SUPPORT
        depends on MINISATIP_NDMS_DVBCSA_SUPPORT && MINISATIP_NDMS_DVBAES_SUPPORT
	bool "CAM module CI/CI+ support"
	default n

config MINISATIP_NDMS_CLIENT_SUPPORT
	bool "SatIP client support"
	default n

endmenu
```
